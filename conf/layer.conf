## conf/layer.conf
```bitbake
# We have a conf and classes directory, add to BBPATH
BBPATH .= ":${LAYERDIR}"

# We have recipes-* directories, add to BBFILES
BBFILES += "${LAYERDIR}/recipes-*/*/*.bb ${LAYERDIR}/recipes-*/*/*.bbappend"
BBFILES_DYNAMIC += " \
	multimedia-layer:${LAYERDIR}/dynamic-layers/multimedia-layer/*/*/*.bbappend \
"

BBFILE_COLLECTIONS += "adlinktech-bsp"
BBFILE_PATTERN_adlinktech-bsp = "^${LAYERDIR}/"
BBFILE_PRIORITY_adlinktech-bsp = "9"

# This should only be incremented on significant changes that will
# cause compatibility issues with other layers
LAYERVERSION_adlinktech-bsp = "1"

LAYERDEPENDS_adlinktech-bsp = "core openembedded-layer meta-python meta-arm"

LAYERSERIES_COMPAT_adlinktech-bsp = "scarthgap"

NON_MULTILIB_RECIPES:remove = " u-boot "



DISTRO_FEATURES:append = " ${@bb.utils.contains("NDA_BUILD", "1", "nda-mtk", "", d)}"
```

## conf/machine/absolute-vision.conf
```bitbake
require conf/machine/include/mt8370.inc
require conf/machine/include/mt7921.inc
require conf/machine/include/absolute-vision.inc

# Kernel
KERNEL_DEVICETREE = "mediatek/absolute-vision.dtb"


# U-Boot
UBOOT_MACHINE = "absolute-vision_mtk510_defconfig"

# libdram
LIBDRAM_BOARD_NAME = "genio-700-evk"

# OP-TEE
#OPTEE_DRAM_SIZE = "0x100000000"

# LK
LK_BOARD_NAME = "genio-510-evk"

MACHINE_FEATURES:append = " alsa bluetooth pci usbgadget usbhost wifi tsn uc-fde"

MACHINEOVERRIDES =. "mt8370-evk:genio-510-evk:"

# onsemi-firmware
ONSEMI_BOARD_NAME = "MediaTek_Genio"
MACHINE_EXTRA_RRECOMMENDS:append = " \
        onsemi-firmware-ap1302-ar0430 \
        onsemi-firmware-ap1302-ar0830 \
"

# Drivers for external I2C device
MACHINE_EXTRA_RRECOMMENDS:append = " \
        ite-it6510-driver \
        lontium-lt6911-driver \
"

DISTRO_FEATURES:remove = "btf"
```

## conf/machine/include/absolute-vision.inc
```bitbake
SUMMARY = "Defines Kernel, U-Boot Patches,device tree, defconfig macros"

# Kernel
KERNEL_CONFIG_AARCH64 = "absolute-vision_mtk510_defconfig"
KERNEL_DEVICETREE = "mediatek/absolute-vision.dtb"

# kernel patches
EXTRA_KERNEL_PATCHES = " \
        file://absolute-vision_mtk510_defconfig \
        file://0001-Add-absolute-vision-support.patch \
	file://0002-Add-RTL8211F-LED-config-and-TPM.patch \
        file://0003-fsource-add-fsource-driver-to-enable-vefuse.patch \
        file://0004-init-HDMI-re-driver-at-HDMI-plug.patch \
        file://0005-Add-read-MAC-address-from-nvmem-support.patch \
	file://0006-Enable-audio-codec-tlv320aic3106.patch \
"
EXTRA_KERNEL_DTS = " \
        file://absolute-vision.dts \
"

KERNEL_SRC_PATCHES ="\
	${EXTRA_KERNEL_PATCHES} \
	${EXTRA_KERNEL_DTS} \
"
```

## conf/machine/include/i300-pumpkin-common.inc
```bitbake
require mt7668.inc

MACHINEOVERRIDES =. "i300-pumpkin:"

# Kernel
DTB_LOADADDRESS = "0x44000000"

# U-Boot
UBOOT_ENTRYPOINT = "0x40200000"
UBOOT_LOADADDRESS = "0x40200000"
UBOOT_DTB_LOADADDRESS = "0x44000000"
UBOOT_DTBO_LOADADDRESS = "0x44c00000"
UBOOT_MACHINE = "mt8516_pumpkin_defconfig"

# TF-A priv
TFA_BOARD_NAME = "mt8516-pumpkin"

# libdram
LIBDRAM_BOARD_NAME = "mt8516-pumpkin"

# LK
LK_PROJECT = "pumpkin8516-emmc"
LK_BOARD_NAME = "${LIBDRAM_BOARD_NAME}"

MACHINE_FEATURES:append = " alsa bluetooth usbgadget usbhost wifi"
```

## conf/machine/include/lec-mtk-i1200.inc
```bitbake
SUMMARY = "Defines Kernel, U-Boot Patches,device tree, defconfig macros"

# Kernel
KERNEL_CONFIG_AARCH64 = "adlink_lec_i1200_defconfig"
KERNEL_DEVICETREE = "mediatek/lec-mtk-i1200-ufs.dtb"

# kernel patches
EXTRA_KERNEL_PATCHES = " \
        file://adlink_lec_i1200_defconfig \
        file://0001-Modify-i2c-imx214-to-support-extra-extension.patch \
        file://0002-Replace-i2c-mbus_code-to-mtk_mbus_code.patch \
        file://0003-Modify-i2c-imx214-driver-to-support-2-4-lane-mode.patch \
	file://0004-Added-display-port-over-DP-connector.patch \
        file://0005-Added-support-for-panel-b101uan01-and-ADLINK-Config.patch \
        file://0006-Added-TPM2.0-Support.patch \
        file://0007-Added-PCIe-compliance-test-support.patch \
        file://0008-Added-support-imx219-camera.patch \
	file://0009-Added-TLV320AIC3C-and-w8960-codec-support.patch \
"

EXTRA_KERNEL_DTS = " \
	file://lec-mtk-i1200-ufs.dts \
        file://lec-mtk-i1200.dts \
	file://mt8195.dtsi \
"

KERNEL_SRC_PATCHES ="\
	${EXTRA_KERNEL_PATCHES} \
	${EXTRA_KERNEL_DTS} \
"

# u-boot
UBOOT_DTB_NAME = "lec-mtk-i1200-ufs.dtb"


# u-boot patches
EXTRA_UBOOT_PATCHES = " \
	file://lec_mtk_i1200_nor_defconfig \
	file://lec_mtk_i1200_nor_8mb_defconfig \
	file://lec_mtk_i1200_ufs_defconfig \	
	file://fw_env.config  \
	file://boot.script \
	file://fdt-env.cfg \
	file://boot.script.its \
	${@bb.utils.contains("DISTRO_FEATURES", "secure-boot", "file://secure-boot.cfg", "", d)} \
	file://fdt-env.cfg \
	file://boot.script.its \
	file://0001-Added-Board-support-for-LEC-MTK-i1200.patch \
	file://0002-Enable-Clock-for-Adlink-configuration.patch \
	file://0003-Added-interfacetest-environment-variable-to-list.patch \
	file://0005-Added-DSI-panel-support.patch \
	file://0006-Eth-power-support.patch \
"
EXTRA_UBOOT_8MB_PATCHES = " ${@bb.utils.contains("MACHINE_FEATURES", "8MB-NOR", " file://0002-Modify-Boot-assets-partition-offset.patch ", "", d)}  "	
EXTRA_UBOOT_PATCHES:append = " ${EXTRA_UBOOT_8MB_PATCHES} "			

EXTRA_UBOOT_DTS = " \
	file://lec-mtk-i1200-ufs.dts \
	file://mt8195.dtsi \
"
UBOOT_SRC_PATCHES = " \
        ${EXTRA_UBOOT_PATCHES} \
        ${EXTRA_UBOOT_DTS} \
"

LK_SRC_PATCHES = "${@bb.utils.contains("MACHINE_FEATURES", "8MB-NOR", " file://0001-Adding-8MB-nor-W25Q64JWXGIQ-support.patch ", "", d)}  "

BL2_SRC_PATCHES = "${@bb.utils.contains("MACHINE_FEATURES", "8MB-NOR", " file://0002-Modify-fip_a-fip_b-misc-partition-offset.patch ", "", d)} "
```

## conf/machine/include/mediatek-common.inc
```bitbake
MACHINEOVERRIDES =. "mtk:"

# Kernel
KERNEL_CLASSES = "kernel-fitimage"
KERNEL_IMAGETYPE = "fitImage"
KERNEL_COMPRESSION = "gzip"

# U-Boot
UBOOT_SUFFIX = "bin"
UBOOT_ENTRYPOINT       = "0x40200000"
UBOOT_LOADADDRESS      = "0x40200000"
UBOOT_DTB_LOADADDRESS  = "0x44000000"
UBOOT_DTBO_LOADADDRESS = "0x44c00000"
UBOOT_SIGN_ENABLE = "1"

# OP-TEE OS
PREFERRED_PROVIDER_virtual/optee-os ?= "optee-os"
PREFERRED_VERSION_optee-client ?= "3.16"
PREFERRED_VERSION_optee-examples ?= "3.16"
PREFERRED_VERSION_optee-os ?= "3.16"
PREFERRED_VERSION_optee-os-tadevkit ?= "3.16"
PREFERRED_VERSION_optee-test ?= "3.16"
OPTEE_TZDRAM_START ?= "0x43200000"
OPTEE_TZDRAM_SIZE  ?= "0x00a00000"

IMAGE_BOOT_FILES = " \
	${KERNEL_IMAGETYPE} \
	${@bb.utils.contains('KERNEL_IMAGETYPE', 'fitImage', '', os.path.basename("${KERNEL_DEVICETREE}"), d)} \
"

IMAGE_FSTYPES ?= "wic.img aiotflash.tar"
IMAGE_ROOTFS_ALIGNMENT = "4"
IMAGE_CLASSES += "image_type_img image_type_aiotflash"

SERIAL_CONSOLES = "921600;ttyS0"

WKS_FILE ?= "mediatek-bootimg.wks"
WIC_CREATE_EXTRA_ARGS += "-i direct-with-blksz"
WIC_SECTOR_SIZE ?= "512"
WIC_BLOCK_SIZE ?= "1024"
WICVARS:append = " WIC_SECTOR_SIZE WIC_BLOCK_SIZE"
do_image_wic[depends] += " \
	trusted-firmware-a:do_deploy \
	virtual/kernel:do_deploy \
"

PREFERRED_PROVIDER_virtual/dtb = "dtbo"
PREFERRED_PROVIDER_virtual/kernel ?= "linux-mtk"
PREFERRED_PROVIDER_virtual/bootloader ?= "u-boot"
PREFERRED_PROVIDER_virtual/lk ?= "${@bb.utils.contains("DISTRO_FEATURES", "nda-mtk", "lk", "lk-prebuilt", d)}"
PREFERRED_PROVIDER_virtual/bl2 ?= "bl2"

PREFERRED_VERSION_linux-mtk ??= "5.15%"

EXTRA_IMAGEDEPENDS = " \
	virtual/lk \
	trusted-firmware-a \
	rity-tools \
"

MACHINE_ESSENTIAL_EXTRA_RDEPENDS += "kernel-image"

MACHINE_EXTRA_RRECOMMENDS += " \
	kernel-modules \
	packagegroup-mtk \
"

# Set this only for factory image
# An image built with this option should not be shipped to customers
OPTEE_RPMB_WRITE_KEY ??= "0"
# Set this only to use the RPMB test key instead of generating an unique one
OPTEE_RPMB_TEST_KEY ??= "0"

MACHINE_EXTRA_RRECOMMENDS:append = " ${@bb.utils.contains("DISTRO_FEATURES", "optee-otp", " optee-otp", "", d)}"

# Set this to sign BL2 and support DAA
BL2_SIGN_ENABLE ??= "0"
DA_SIGN_ENABLE ??= "0"

# Set this to generate the secure package required to enable secure boot
SECURE_ZIP_ENABLE ??= "0"

IMAGE_CLASSES:append = "${@oe.utils.conditional('SECURE_ZIP_ENABLE', '1', ' image_type_secure_package', '', d)}"
IMAGE_FSTYPES:append = "${@oe.utils.conditional('SECURE_ZIP_ENABLE', '1', ' secure.zip', '', d)}"

# Allowed license for mtk device - overrideable if necessary
MTK_EXTRA_LICENSE_FLAGS_ACCEPTED ?= "commercial"

# Packages requiring extra licenses
LICENSE_FLAGS_ACCEPTED:append:pn-libmali = " ${MTK_EXTRA_LICENSE_FLAGS_ACCEPTED}"
```

## conf/machine/include/mt7663.inc
```bitbake
MTK_WIRELESS_RELEASE ?= "alps-release-r0.mp5-aiot"
MTK_WIRELESS_CHIP = "MT7663"
MACHINEOVERRIDES =. "mt7663:"

MT7663_WIFI_USE_UPSTREAM_DRV ??= "${@bb.utils.contains('DISTRO_FEATURES', 'nda-mtk', '0', '1', d)}"

WIFI_OSS_PKGS = "kernel-module-mt7663s mt7663-service"
WIFI_NDA_PKGS = "kernel-module-mt7663-tk-wifi wifitest"
WIFI_PKGS = "${@bb.utils.contains('MT7663_WIFI_USE_UPSTREAM_DRV', '1', '${WIFI_OSS_PKGS}', '${WIFI_NDA_PKGS}', d)}"

BT_OSS_PKGS = "kernel-module-btmtksdio linux-firmware-mt7663"

MACHINE_EXTRA_RRECOMMENDS:append = " \
	${@bb.utils.contains('DISTRO_FEATURES', 'wifi', '${WIFI_PKGS}', '', d)} \
	${@bb.utils.contains('DISTRO_FEATURES', 'bluetooth', '${BT_OSS_PKGS}', '', d)} \
"
```

## conf/machine/include/mt7668.inc
```bitbake
MTK_WIRELESS_RELEASE ?= "alps-release-r0.mp5-aiot"
MTK_WIRELESS_CHIP = "MT7668"
MACHINEOVERRIDES =. "mt7668:"

MACHINE_EXTRA_RRECOMMENDS:append = " \
	${@bb.utils.contains("DISTRO_FEATURES", "nda-mtk wifi", "kernel-module-mt7668-tk-wifi", "", d)} \
	${@bb.utils.contains("DISTRO_FEATURES", "bluetooth", "linux-firmware-mt7668", "", d)} \
	${@bb.utils.contains("DISTRO_FEATURES", "nda-mtk", "wifitest", "", d)} \
"
```

## conf/machine/include/mt7921.inc
```bitbake
MACHINEOVERRIDES =. "mt7921:"

MACHINE_EXTRA_RRECOMMENDS:append = " \
	${@bb.utils.contains("DISTRO_FEATURES", "wifi", "kernel-module-mt7921e linux-firmware-mt7961", "", d)} \
"
```

## conf/machine/include/mt8183.inc
```bitbake
require conf/machine/include/arm/armv8a/tune-cortexa73-cortexa53.inc
require conf/machine/include/soc-family.inc
require mediatek-common.inc

SOC_FAMILY = "mt8183"

# Trusted Firmware-A
TFA_PLATFORM = "mt8183"

# OP-TEE
OPTEE_TARGET = "mediatek-mt8183"
OPTEE_DRAM_SIZE = "0x80000000"

# LK
LK_PROJECT = "mt8183-evb"

MACHINE_FEATURES:append = " optee"
MACHINE_FEATURES:append = " ${@bb.utils.contains("DISTRO_FEATURES", "nda-mtk", "optee-efuse", "", d)}"

DISTRO_FEATURES:remove = " x11 "

# Mali
KERNEL_MODULE_AUTOLOAD += "dma-buf-test-exporter"
MALI_SOC = "mt8183"
MALI_VERSION ??= "r32p0"

MACHINE_EXTRA_RRECOMMENDS:append = " \
	${@bb.utils.contains_any('DISTRO_FEATURES', 'opengl vulkan', 'libmali', '', d)} \
	linux-firmware-mt8183-scp \
	${@bb.utils.contains("MACHINE_FEATURES", "optee-efuse", "optee-ewriter", "", d)} \
"

PREFERRED_PROVIDER_virtual/egl ?= "libmali"
PREFERRED_PROVIDER_virtual/libegl ?= "libmali"
PREFERRED_PROVIDER_virtual/libgbm ?= "libmali"
PREFERRED_PROVIDER_virtual/libgl ?= "libmali"
PREFERRED_PROVIDER_virtual/libgles1 ?= "libmali"
PREFERRED_PROVIDER_virtual/libgles2 ?= "libmali"
PREFERRED_PROVIDER_virtual/mesa ?= "libmali"
PREFERRED_PROVIDER_virtual/opencl ?= "libmali"

MACHINEOVERRIDES =. "mt8385:i500:"
```

## conf/machine/include/mt8516.inc
```bitbake
require conf/machine/include/arm/armv8a/tune-cortexa35.inc
require conf/machine/include/soc-family.inc
require mediatek-common.inc

SOC_FAMILY = "mt8516"

# Trusted Firmware-A
PREFERRED_PROVIDER_virtual/bl2 = "bl2-prebuilt"

# OP-TEE
OPTEE_TARGET = "mediatek-mt8516"
OPTEE_DRAM_SIZE = "0x40000000"

USE_VT = "0"

MACHINE_FEATURES:append = " optee"

MACHINEOVERRIDES =. "mt8362:mt8362b:i300:i300b:"
```

## conf/machine/lec-mtk-i1200-ufs.conf
```bitbake
#machine configuration file for LEC-MTK

require conf/machine/include/mt8195.inc
require conf/machine/include/mt7921.inc

require conf/machine/include/lec-mtk-i1200.inc


# U-Boot
UBOOT_MACHINE = "lec_mtk_i1200_ufs_defconfig"


# libdram
LIBDRAM_BOARD_NAME = "genio-1200-evk-ufs"

# OP-TEE
OPTEE_DRAM_SIZE = "0x200000000"

# LK
LK_PROJECT = "mt8395-evk-ufs"
LK_BOARD_NAME = "${LK_PROJECT}"

# UFS storage
WIC_SECTOR_SIZE = "4096"
WIC_BLOCK_SIZE = "4096"
MACHINE_FEATURES:append = " ufs-boot ufs-system"

MACHINE_FEATURES:append = " alsa bluetooth pci usbgadget usbhost wifi tsn"

MACHINEOVERRIDES =. "mt8395-evk:genio-1200-evk:mt8395-evk-ufs:genio-1200-evk-ufs:"
```
