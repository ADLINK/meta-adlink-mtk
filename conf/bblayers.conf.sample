## conf/bblayers.conf.sample
```bitbake
# POKY_BBLAYERS_CONF_VERSION is increased each time build/conf/bblayers.conf
# changes incompatibly
POKY_BBLAYERS_CONF_VERSION = "2"

BBPATH = "${TOPDIR}"
BBFILES ?= ""

BBLAYERS ?= " \
  ##OEROOT##/meta \
  ##OEROOT##/meta-poky \
  ##OEROOT##/meta-yocto-bsp \
  ##OEROOT##/../meta-arm/meta-arm \
  ##OEROOT##/../meta-arm/meta-arm-toolchain \
  ##OEROOT##/../meta-clang \
  ##OEROOT##/../meta-mediatek-bsp \
  ##OEROOT##/../meta-mediatek-tsn \
  ##OEROOT##/../meta-mediatek-bluedroid \
  ##OEROOT##/../meta-mediatek-demo \
  ##OEROOT##/../meta-nn \
  ##OEROOT##/../meta-adlink-mtk \
  ##OEROOT##/../meta-stress-test \
  ##OEROOT##/../meta-security \
  ##OEROOT##/../meta-openembedded/meta-multimedia \
  ##OEROOT##/../meta-openembedded/meta-filesystems \
  ##OEROOT##/../meta-openembedded/meta-networking \
  ##OEROOT##/../meta-openembedded/meta-oe \
  ##OEROOT##/../meta-openembedded/meta-python \
  ##OEROOT##/../meta-openembedded/meta-perl \
  ##OEROOT##/../meta-rity/meta \
  ##OEROOT##/../meta-rity/meta-rity-bringup \
  ##OEROOT##/../meta-rity/meta-rity-bsp \
  ##OEROOT##/../meta-rity/meta-rity-demo \
  ##OEROOT##/../meta-tensorflow \
  "

# lec-mtk1200 specific layers
BBLAYERS += "${@'${TOPDIR}/../src/meta-browser/meta-chromium' if d.getVar('MACHINE') == 'lec-mtk1200' and os.path.exists(d.getVar('TOPDIR') + '/../src/meta-browser/meta-chromium') else ''}"
BBLAYERS += "${@'${TOPDIR}/../src/meta-lts-mixins' if d.getVar('MACHINE') == 'lec-mtk1200' and os.path.exists(d.getVar('TOPDIR') + '/../src/meta-lts-mixins') else ''}"

# osm-mtk510 specific layer
BBLAYERS += "${@'${TOPDIR}/../src/meta-qt5' if d.getVar('MACHINE') == 'osm-mtk510' and os.path.exists(d.getVar('TOPDIR') + '/../src/meta-qt5') else ''}"
```

## conf/machine/include/osm-520.inc
```bitbake
SUMMARY = "Defines Kernel patches, device tree and defconfig macros for OSM-520"

MACHINEOVERRIDES =. "osm-520:"

# Kernel
KERNEL_DEFCONFIG = "osm-520_mtk520_defconfig"
KERNEL_DEVICETREE = "mediatek/osm-520_mtk520.dtb"

# kernel patches
EXTRA_KERNEL_PATCHES = " \
	file://osm-520_mtk520_defconfig \
	file://0001-Add-osm-520-support.patch \
	file://0002-Enable-GPIO-control-node.patch \
	file://0003-Add-read-MAC-address-from-nvmem-support.patch \
	file://0007-Add-SKU-and-PCB-INFO.patch \
	file://0009-Modify-RTL8211F-LED-activity.patch \
	file://0010-Add-DP-direct-output-for-V25.1-kernel-6.6.92.patch \
	file://0013-modify-i2sout0-share-i2sin0-clock.patch \
	file://0014-mt8189-aic3107-set-codec-sysclk.patch \
	file://0015-tlv3107-mic.patch \
"

EXTRA_KERNEL_DTS = " \
	file://osm-520_mtk520-ufs.dts \
	file://osm-520_mtk520.dts \
	file://osm-520_mtk520_core.dts \
"

KERNEL_SRC_PATCHES = "\
	${EXTRA_KERNEL_PATCHES} \
	${EXTRA_KERNEL_DTS} \
"

# u-boot defconfigs
EXTRA_UBOOT_PATCHES = " \
	file://osm_520_emmc_defconfig \
	file://osm_520_ufs_defconfig \
	file://osm_520_ufs_qspi_defconfig \
"

EXTRA_UBOOT_DTS = " \
	file://osm-520-emmc.dts \
	file://osm-520-ufs.dts \
	file://osm-520-ufs-qspi.dts \
"

UBOOT_SRC_PATCHES = " \
	${EXTRA_UBOOT_PATCHES} \
	${EXTRA_UBOOT_DTS} \
"
```

## conf/machine/include/osm-mtk510.inc
```bitbake
require conf/machine/include/arm/arch-armv8a.inc
require conf/machine/include/soc-family.inc
require mediatek-common.inc

SOC_FAMILY = "mt8370"
SOC_SRAM_ADDR = "0x201000"

# Trusted Firmware-A
TFA_PLATFORM = "mt8188"

# OP-TEE
OPTEE_TARGET = "mediatek-mt8370"
OPTEE_DRAM_SIZE = "0x80000000"

# LK
LK_PROJECT = "mt8390-evk"

MACHINE_FEATURES:append = " optee"
MACHINE_FEATURES:append = " ${@bb.utils.contains("DISTRO_FEATURES", "nda-mtk", "optee-efuse", "", d)}"

# Mali
# Arm Mali GPU driver & graphics library provider

# By default, Rity images come with graphics support using the Mali DDK
# driver and libmali userspace library.
#
# To use Panfrost driver and Mesa, set the following values in your conf files.
# (local.conf, machine conf or distro conf):
# GPU_DRIVER = "panfrost"
# GPU_LIB = "mesa"
GPU_DRIVER ??= "mali-gpu-driver"
GPU_LIB ??= "libmali"

# If GPU_LIB is "libmali",
# each SoC needs to define MALI_SOC and MALI_VERSION (DDK version)
MALI_SOC ??= "mt8188"
MALI_VERSION ??= "48"

# Mali DDK does not support x11
DISTRO_FEATURES:remove = " x11 "

MACHINEOVERRIDES:append = ":mt7921:mt7925:"

MACHINE_EXTRA_RRECOMMENDS:append = "\
    ${@bb.utils.contains_any('DISTRO_FEATURES', 'opengl vulkan', '${GPU_LIB}', '', d)} \
    ${@bb.utils.contains_any('GPU_DRIVER', 'mali-gpu-driver', 'mali-gpu-driver', '', d)} \
    linux-firmware-mt8188-scp \
    linux-firmware-mt8188-sof \
    ${@bb.utils.contains("MACHINE_FEATURES", "optee-efuse", "optee-ewriter", "", d)} \
    ${@bb.utils.contains("DISTRO_FEATURES", "wifi", "kernel-module-mt7921e linux-firmware-mt7961", "", d)} \
    ${@bb.utils.contains("DISTRO_FEATURES", "wifi", "kernel-module-mt7925e linux-firmware-mt7925", "", d)} \
"

PREFERRED_PROVIDER_virtual/egl ?= "${GPU_LIB}"
PREFERRED_PROVIDER_virtual/libegl ?= "${GPU_LIB}"
PREFERRED_PROVIDER_virtual/libgbm ?= "${GPU_LIB}"
PREFERRED_PROVIDER_virtual/libgl ?= "${GPU_LIB}"
PREFERRED_PROVIDER_virtual/libgles1 ?= "${GPU_LIB}"
PREFERRED_PROVIDER_virtual/libgles2 ?= "${GPU_LIB}"
PREFERRED_PROVIDER_virtual/libgles3 ?= "${GPU_LIB}"
PREFERRED_PROVIDER_virtual/mesa ?= "${GPU_LIB}"
PREFERRED_PROVIDER_virtual/opencl ?= "${GPU_LIB}"


MACHINEOVERRIDES =. "mt8370:genio-510:"

# Kernel
KERNEL_DEFCONFIG = "adlink_osm_mtk510_defconfig"
KERNEL_CONFIG_AARCH64 = "adlink_osm_mtk510_defconfig"
KERNEL_DEVICETREE = "mediatek/osm-mtk510.dtb"

# kernel patches
EXTRA_KERNEL_PATCHES = " \
        file://adlink_osm_mtk510_defconfig \
	file://0001-Add-ADLINKTECH-boards-support.patch \
	file://0002-init-HDMI-re-driver-at-HDMI-plug.patch \
        file://0003-Add-RTL8211F-LED-config.patch \
        file://0004-Add-phy-dp83867-LED-setup.patch \
        file://0005-Add-read-MAC-address-from-nvmem-support.patch \
        file://0006-Add-fsource-driver-to-enable-vefuse.patch \
        file://0007-Add-SKU-and-PCB-INFO.patch \
        file://0008-Add-DP-direct-output-for-V25.1-kernel-6.6.92.patch \
        file://0009-b080uan01-dsi-panel-DCS-reboot-init-sequence.patch \
	file://0010-tlv3107-mic.patch \
        file://0011-mt8188-set-codec-sysclk.patch \
        file://0012-Setting-PWM_BL-stays-always-on-for-DSI.patch \
"
EXTRA_KERNEL_DTS = " \
        file://osm-mtk510.dts \
"

KERNEL_SRC_PATCHES ="\
	${EXTRA_KERNEL_PATCHES} \
	${EXTRA_KERNEL_DTS} \
"
# U-Boot defconfig
EXTRA_UBOOT_PATCHES = " \
	file://adlink_osm_mtk510_defconfig \
	file://0002-Implement-different-dtbo-for-SKU-and-PCB-detection.patch \
"

EXTRA_UBOOT_DTS = " \
        file://osm-mtk510.dts \
"

UBOOT_SRC_PATCHES = " \
        ${EXTRA_UBOOT_PATCHES} \
        ${EXTRA_UBOOT_DTS} \
"
```

## conf/machine/include/osm-mtk520.inc
```bitbake
SUMMARY = "Defines Kernel patches, device tree and defconfig macros for OSM-MTK520"

MACHINEOVERRIDES =. "osm-mtk520:"

# Kernel
KERNEL_DEFCONFIG = "osm_mtk520_defconfig"
KERNEL_DEVICETREE = "mediatek/osm-mtk520.dtb"

# kernel patches
EXTRA_KERNEL_PATCHES = " \
	file://osm_mtk520_defconfig \
	file://0001-Add-osm-mtk520-support.patch \
	file://0002-Enable-GPIO-control-node.patch \
	file://0003-Add-read-MAC-address-from-nvmem-support.patch \
	file://0007-Add-SKU-and-PCB-INFO.patch \
	file://0009-Modify-RTL8211F-LED-activity.patch \
	file://0010-Add-DP-direct-output-for-V25.1-kernel-6.6.92.patch \
	file://0013-modify-i2sout0-share-i2sin0-clock.patch \
	file://0014-mt8189-aic3107-set-codec-sysclk.patch \
	file://0015-tlv3107-mic.patch \
"

EXTRA_KERNEL_DTS = " \
	file://osm-mtk520-ufs.dts \
	file://osm-mtk520.dts \
	file://osm-mtk520-core.dts \
"

KERNEL_SRC_PATCHES = "\
	${EXTRA_KERNEL_PATCHES} \
	${EXTRA_KERNEL_DTS} \
"

# u-boot defconfigs
EXTRA_UBOOT_PATCHES = " \
	file://osm_mtk520_emmc_defconfig \
	file://osm_mtk520_ufs_defconfig \
	file://osm_mtk520_ufs_qspi_defconfig \
"

EXTRA_UBOOT_DTS = " \
	file://osm-mtk520-emmc.dts \
	file://osm-mtk520-ufs.dts \
	file://osm-mtk520-ufs-qspi.dts \
"

UBOOT_SRC_PATCHES = " \
	${EXTRA_UBOOT_PATCHES} \
	${EXTRA_UBOOT_DTS} \
"
```

## conf/machine/lec-mtk-i1200-qspi.conf
```bitbake
#machine configuration file for LEC-MTK

require conf/machine/include/mt8195.inc
require conf/machine/include/mt7921.inc
require conf/machine/include/ubifs-macronix-mx25u25635F.inc
require conf/machine/include/lec-mtk-i1200.inc

EXTRA_UBOOT_8MB_DEFCONFIG = " ${@bb.utils.contains("MACHINE_FEATURES", "8MB-NOR", "lec_mtk_i1200_nor_8mb_defconfig", "lec_mtk_i1200_nor_defconfig", d)}  "
# TF-A NOR layout (BSP 25.1+)
# Must match CONFIG_MTDPARTS_DEFAULT in the selected U-Boot defconfig:
#   8MB-NOR : lec_mtk_i1200_nor_8mb_defconfig
#   default : lec_mtk_i1200_nor_defconfig
TFA_NOR_FIP_ADDR   = "${@bb.utils.contains('MACHINE_FEATURES', '8MB-NOR', '0x80000',  '0x400000',  d)}"
TFA_NOR_FIP_LENGTH = "${@bb.utils.contains('MACHINE_FEATURES', '8MB-NOR', '0x200000', '0x400000',  d)}"
TFA_NOR_DRAMK_ADDR = "${@bb.utils.contains('MACHINE_FEATURES', '8MB-NOR', '0x500000', '0x1400000', d)}"
TFA_NOR_MISC_ADDR  = "${@bb.utils.contains('MACHINE_FEATURES', '8MB-NOR', '0x580000', '0x1480000', d)}"

# U-Boot
UBOOT_MACHINE = " ${EXTRA_UBOOT_8MB_DEFCONFIG} "

#FIXME libdram for nor support
LIBDRAM_BOARD_NAME = "genio-1200-evk-ufs"

# OP-TEE
OPTEE_DRAM_SIZE = "0x200000000"

# LK
LK_PROJECT = "mt8395-evk-norboot-ufs"
LK_BOARD_NAME = "${LK_PROJECT}"

# UFS storage
WIC_SECTOR_SIZE = "4096"
WIC_BLOCK_SIZE = "4096"

OVERRIDES .= ":nor-boot"

MACHINE_FEATURES:append = " nor-boot ufs-system"
MACHINE_FEATURES:append = " alsa bluetooth pci usbgadget usbhost wifi tsn uc-fde"

MACHINEOVERRIDES =. "mt8395-evk:genio-1200-evk:mt8395-evk-norboot-ufs:genio-1200-evk-norboot-ufs:lec-mtk1200:"
```

## conf/machine/osm-520-norboot-ufs.conf
```bitbake
require conf/machine/include/mt8391.inc
require conf/machine/include/mt7921.inc
require conf/machine/include/mt7925.inc
require conf/machine/include/ubifs-macronix-mx25u12832F.inc
require conf/machine/include/osm-520.inc

# Kernel
KERNEL_DEVICETREE = "mediatek/osm-520_mtk520.dtb"

# U-Boot
UBOOT_MACHINE = "osm_520_ufs_qspi_defconfig"
UBOOT_DTB_NAME = "osm-520-ufs-qspi.dtb"

# libdram
LIBDRAM_BOARD_NAME = "genio-720-evk"

# OP-TEE
OPTEE_DRAM_SIZE = "0x200000000"

# LK
LK_PROJECT = "mt8391-evk-norboot-ufs"
LK_BOARD_NAME = "${LK_PROJECT}"

# Trusted Firmware-A
TFA_NOR_FIP_ADDR = "0x200000"
TFA_NOR_FIP_LENGTH = "0x200000"
TFA_NOR_DRAMK_ADDR = "0xA00000"
TFA_NOR_MISC_ADDR = "0xA80000"

OVERRIDES .= ":nor-boot"

MACHINE_FEATURES:append = " nor-boot"
MACHINE_FEATURES:append = " alsa bluetooth pci usbgadget usbhost wifi tsn uc-fde"

MACHINEOVERRIDES =. "mt8391-evk:genio-720-evk:mt8391-evk-norboot-ufs:genio-720-evk-norboot-ufs:"

# onsemi-firmware
ONSEMI_BOARD_NAME = "MediaTek_Genio"
```

## conf/machine/osm-520-ufs.conf
```bitbake
require conf/machine/include/mt8391.inc
require conf/machine/include/mt7921.inc
require conf/machine/include/mt7925.inc
require conf/machine/include/osm-520.inc

# Kernel
KERNEL_DEVICETREE = "mediatek/osm-520_mtk520.dtb"

# U-Boot
UBOOT_MACHINE = "osm_520_ufs_defconfig"
UBOOT_DTB_NAME = "osm-520-ufs.dtb"

# libdram
LIBDRAM_BOARD_NAME = "genio-720-evk"

# OP-TEE
OPTEE_DRAM_SIZE = "0x200000000"

# LK
LK_BOARD_NAME = "${LIBDRAM_BOARD_NAME}"

# UFS storage
WIC_SECTOR_SIZE = "4096"
WIC_BLOCK_SIZE = "4096"
MACHINE_FEATURES:append = " ufs-boot ufs-system"

MACHINE_FEATURES:append = " alsa bluetooth pci usbgadget usbhost wifi tsn uc-fde"

MACHINEOVERRIDES =. "mt8391-evk:genio-720-evk:mt8391-evk-ufs:genio-720-evk-ufs:"

# onsemi-firmware
ONSEMI_BOARD_NAME = "MediaTek_Genio"
```

## conf/machine/osm-mtk510.conf
```bitbake
require include/osm-mtk510.inc
require conf/machine/include/mt7921.inc

# U-Boot
UBOOT_MACHINE = "adlink_osm_mtk510_defconfig"

# libdram
LIBDRAM_BOARD_NAME = "genio-700-evk"

# LK
LK_BOARD_NAME = "genio-510-evk"

MACHINE_FEATURES:append = " alsa bluetooth pci usbgadget usbhost wifi tsn uc-fde"

MACHINEOVERRIDES =. "mt8370-evk:genio-510-evk:"

# onsemi-firmware
ONSEMI_BOARD_NAME = "MediaTek_Genio"
MACHINE_EXTRA_RRECOMMENDS:append = " \
        onsemi-firmware-ap1302-ar0430 \
        onsemi-firmware-ap1302-ar0830 \
"
```

## conf/machine/osm-mtk520-emmc.conf
```bitbake
require conf/machine/include/mt8391.inc
require conf/machine/include/mt7921.inc
require conf/machine/include/mt7925.inc
require conf/machine/include/osm-mtk520.inc

# Kernel
KERNEL_DEVICETREE = "mediatek/osm-mtk520.dtb"

# U-Boot
UBOOT_MACHINE = "osm_mtk520_emmc_defconfig"
UBOOT_DTB_NAME = "osm-mtk520-emmc.dtb"

# libdram
LIBDRAM_BOARD_NAME = "genio-720-evk"

# OP-TEE
OPTEE_DRAM_SIZE = "0x200000000"

# LK
LK_BOARD_NAME = "${LIBDRAM_BOARD_NAME}"

MACHINE_FEATURES:append = " alsa bluetooth pci usbgadget usbhost wifi tsn uc-fde"

MACHINEOVERRIDES =. "mt8391-evk:genio-720-evk:"

# onsemi-firmware
ONSEMI_BOARD_NAME = "MediaTek_Genio"

IMAGE_FSTYPES += " wic"
```

## conf/machine/osm-mtk520-ufs.conf
```bitbake
require conf/machine/include/mt8391.inc
require conf/machine/include/mt7921.inc
require conf/machine/include/mt7925.inc
require conf/machine/include/osm-mtk520.inc

# Kernel
KERNEL_DEVICETREE = "mediatek/osm-mtk520.dtb"

# U-Boot
UBOOT_MACHINE = "osm_mtk520_ufs_defconfig"
UBOOT_DTB_NAME = "osm-mtk520-ufs.dtb"

# libdram
LIBDRAM_BOARD_NAME = "genio-720-evk"

# OP-TEE
OPTEE_DRAM_SIZE = "0x200000000"

# LK
LK_BOARD_NAME = "${LIBDRAM_BOARD_NAME}"

# UFS storage
WIC_SECTOR_SIZE = "4096"
WIC_BLOCK_SIZE = "4096"
MACHINE_FEATURES:append = " ufs-boot ufs-system"

MACHINE_FEATURES:append = " alsa bluetooth pci usbgadget usbhost wifi tsn uc-fde"

MACHINEOVERRIDES =. "mt8391-evk:genio-720-evk:mt8391-evk-ufs:genio-720-evk-ufs:"

# onsemi-firmware
ONSEMI_BOARD_NAME = "MediaTek_Genio"
```
