/dts-v1/;
/plugin/;

/ {
	fragment@0 {
		target = <&tlv320aic310x>;
		__overlay__ {
			status = "okay";
		};
	};

	fragment@1 {
		target = <&sound>;
		__overlay__ {
			dai-link-1 {
				sound-dai = <&afe>;
				dai-link-name = "ETDM1_OUT_BE";
				codec-0 {
					sound-dai = <&tlv320aic310x>;
				};
			};
		};
	};
};
