/dts-v1/;
/plugin/;

/ {
	fragment@0 {
		target = <&dsi0>;
		__overlay__ {
			status = "okay";
		};
	};

	fragment@1 {
		target = <&mipi_tx0>;
		__overlay__ {
			status = "okay";
		};
	};

	fragment@2 {
		target = <&disp_pwm0>;
		__overlay__ {
			status = "okay";
		};
	};

	fragment@3 {
		/* DSI0 does not support dualpipe output,
		   so explicitly disable dualpipe by disabling ovl1 node */
		target = <&ovl1>;
		__overlay__ {
			status = "disabled";
		};
	};
};
