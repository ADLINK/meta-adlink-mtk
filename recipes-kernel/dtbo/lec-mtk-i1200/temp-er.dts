/dts-v1/;
/plugin/;

/ {
        fragment@0 {
		target-path = "/thermal-zones/soc_max/trips";
                __overlay__ {
			trip-point@0 {
				temperature = <75000>;
			};
			target@1 {
				temperature = <100000>;
			};
			soc_max_crit@0 {
				temperature = <115000>;
			};
		};

	};
};
