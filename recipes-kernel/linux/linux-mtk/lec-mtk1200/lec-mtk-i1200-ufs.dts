// SPDX-License-Identifier: (GPL-2.0 OR MIT)
/*
 * Copyright (C) 2023 MediaTek Inc.
 */
/dts-v1/;
#include "lec-mtk-i1200.dts"

&ufshci {
	status = "okay";
	vcc-supply = <&mt6359_vemc_1_ldo_reg>;
	vccq2-supply = <&mt6359_vufs_ldo_reg>;
};

&ufsphy {
	status = "okay";
};

&mmc0 {
	status = "disabled";
};

/ {
	model = "Adlinktech LEC-MTK-I1200 board with UFS storage";
};
