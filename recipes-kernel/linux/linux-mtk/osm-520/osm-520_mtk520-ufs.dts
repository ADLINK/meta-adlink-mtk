// SPDX-License-Identifier: (GPL-2.0 OR MIT)
/*
 * Copyright (C) 2023 MediaTek Inc.
 */
/dts-v1/;
#include "osm-520_mtk520.dts"

&ufshci {
        status = "okay";
        vcc-supply = <&mt6359_vemc_1_ldo_reg>;
        vccq2-supply = <&mt6359_vufs_ldo_reg>;
};

&ufsphy {
        status = "okay";
};

&mmc0 {
        status = "disabled";
};

/ {
        model = "Adlinktech OSM-520 board with UFS storage";
};
